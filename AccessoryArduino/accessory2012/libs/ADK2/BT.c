/*
 * Copyright (C) 2012 The Android Open Source Project
 *
 * Licensed under the Apache License, Version 2.0 (the "License");
 * you may not use this file except in compliance with the License.
 * You may obtain a copy of the License at
 *
 *      http://www.apache.org/licenses/LICENSE-2.0
 *
 * Unless required by applicable law or agreed to in writing, software
 * distributed under the License is distributed on an "AS IS" BASIS,
 * WITHOUT WARRANTIES OR CONDITIONS OF ANY KIND, either express or implied.
 * See the License for the specific language governing permissions and
 * limitations under the License.
 */
#define ADK_INTERNAL
#include "fwk.h"
#include "BT.h"
#include "HCI.h"
#include "dbg.h"
#include "coop.h"
#include "sgBuf.h"

#define BT_VERBOSE		0

#define PACKET_RX_BACKLOG_SZ	4

extern const uint8_t cc256x_init_script[];

static uint8_t* backlog[PACKET_RX_BACKLOG_SZ] = {0, };
static uint8_t btThreadDie;
static BtFuncs cbks;

#define RESET		PORTA(0)
#define TX		PORTA(10)
#define RX		PORTA(11)
#define RTS		PORTB(25)
#define CTS		PORTB(26)


static uint32_t packetStore[(BT_RX_BUF_SZ + 3) >> 2];
static uint8_t* packet = (uint8_t*)packetStore;
static uint8_t pageState;
static uint16_t gAclPacketsCanSend = 0;

typedef struct BtEnqueuedNode{

    struct BtEnqueuedNode* next;

    sg_buf* buf;
    uint16_t conn;
    char first;
    uint8_t bcastType

}BtEnqueuedNode;

BtEnqueuedNode* enqueuedPackets = NULL;

static char btDiscoverableConnectable(void);

static void initBtUart(char initial){

    uint32_t speed = initial ? 115200 : BT_BAUDRATE;
    if(initial){

        PMC_EnablePeripheral(ID_USART0);

        gpioSetFun(RESET, GPIO_FUNC_GPIO);
        gpioSetDir(RESET, 0);
        gpioSetVal(RESET, 0);

        gpioSetFun(RX, GPIO_FUNC_A);
        gpioSetFun(TX, GPIO_FUNC_A);
        gpioSetFun(RTS, GPIO_FUNC_A);
        gpioSetFun(CTS, GPIO_FUNC_A);
    }
    USART0->US_CR = US_CR_RSTRX | US_CR_RSTTX | US_CR_RXDIS | US_CR_TXDIS;
    USART0->US_MR = US_MR_USART_MODE_HW_HANDSHAKING | US_MR_USCLKS_MCK | US_MR_CHRL_8_BIT | US_MR_PAR_NO | US_MR_NBSTOP_1_BIT | US_MR_CHMODE_NORMAL;
    USART0->US_BRGR = (BOARD_MCK >> 4) / speed;
    USART0->US_CR = US_CR_RSTRX | US_CR_RSTTX | US_CR_TXDIS | US_CR_RXDIS | US_CR_RSTSTA | US_CR_RTSEN;
    USART0->US_CR = US_CR_TXEN;
    USART0->US_CR = US_CR_RXEN;
}

static void btUartSend(const uint8_t* buf, uint32_t sz){

    while (sz--){
        while (!(USART0->US_CSR & US_CSR_TXRDY));
        USART0->US_THR = *buf++;
    }
}

static void btUartRecv(uint8_t* buf, uint32_t num){	//recv..hang until we have what we wanted

    USART0->US_RPR = (uint32_t)buf;
    USART0->US_RCR = num;
    USART0->US_PTCR = US_PTCR_RXTEN;
    while(USART0->US_RCR) coopYield();
}

static uint8_t* hciCmdPacketStart(uint16_t ogf, uint16_t ocf){		//start a packet in "packet", return "state" pointer

    HCI_Cmd* cmd = (HCI_Cmd*)packetStore;

    cmd->opcode = HCI_OPCODE(ogf, ocf);
    return packet + 3;
}

static uint8_t* hciCmdPacketAddU32(uint8_t* state, uint32_t val){	//add a uint32 to packet, update state

    *state++ = val;
    *state++ = val >> 8;
    *state++ = val >> 16;
    *state++ = val >> 24;

    return state;
}

static uint8_t* hciCmdPacketAddU24(uint8_t* state, uint32_t val){	//add a uint24 to packet, update state

    *state++ = val;
    *state++ = val >> 8;
    *state++ = val >> 16;

    return state;
}

static uint8_t* hciCmdPacketAddU16(uint8_t* state, uint16_t val){	//add a uint32 to packet, update state

    *state++ = val;
    *state++ = val >> 8;

    return state;
}

static uint8_t* hciCmdPacketAddU8(uint8_t* state, uint8_t val){		//add a uint32 to packet, update state

    *state++ = val;

    return state;
}

static uint32_t hciCmdPacketFinish(uint8_t* state){			//finish, return size to send

    HCI_Cmd* cmd = (HCI_Cmd*)packetStore;
    uint32_t paramLen = state - packet - 3;

    cmd->totalParamLen = paramLen;
    return paramLen + 3;
}

static void btTxCmdPacketEx(const HCI_Cmd* cmd){

    uint8_t typ = UART_PKT_TYP_CMD;

    btUartSend(&typ, 1);
    btUartSend((uint8_t*)cmd, 3 + cmd->totalParamLen);	//cannot use sizeof thanks to gcc
}

static void btTxCmdPacket(void){

   btTxCmdPacketEx((HCI_Cmd*)packetStore);
}

static void btAclDataTxBuf(uint16_t conn, char first, uint8_t bcastType, const uint8_t* data, uint16_t sz){

    uint8_t typ = UART_PKT_TYP_ACL;
    HCI_ACL_Data* acl = (HCI_ACL_Data*)packetStore;
    acl->info = conn | (first ? 0x2000 : 0x1000) | ((uint32_t)bcastType) << 14;
    acl->totalDataLen = sz;

    btUartSend(&typ, 1);
    btUartSend((uint8_t*)acl, 4);
    btUartSend(data, sz);
}

static void btAclDoDataTx(uint16_t conn, char first, uint8_t bcastType, sg_buf* buf){

    sg_iter iter;
    uint8_t typ = UART_PKT_TYP_ACL;
    HCI_ACL_Data* acl = (HCI_ACL_Data*)packetStore;
    const uint8_t* data;
    uint32_t len;

    gAclPacketsCanSend --;
    acl->info = conn | (first ? 0x2000 : 0x1000) | ((uint32_t)bcastType) << 14;
    acl->totalDataLen = sg_length(buf);

    btUartSend(&typ, 1);
    btUartSend((uint8_t*)acl, 4);
    iter = sg_iter_start(buf);
    while(sg_iter_next(&iter, &data, &len))  btUartSend(data, len);

    sg_free(buf);
    free(buf);
}

void btAclDataTx(uint16_t conn, char first, uint8_t bcastType, sg_buf* buf){

    if(gAclPacketsCanSend){

        btAclDoDataTx(conn, first, bcastType, buf);
    }
    else{

        BtEnqueuedNode *q = enqueuedPackets, *n = malloc(sizeof(BtEnqueuedNode));
        if(!n){

            //packet dropped due to lack of memory...sorry
            sg_free(buf);
            free(buf);
            return;
        }
        n->buf = buf;
        n->conn = conn;
        n->first = first;
        n->bcastType = bcastType;
        n->next = NULL;

        while(q && q->next) q = q->next;
        if(q) q->next = n;
        else enqueuedPackets = n;
    }
}

static void btEnqueuePacket(uint8_t typ){	//we got a packet but it's not for us - enqueue it for someone else to use

    uint8_t* copy;
    unsigned sz, i;

    switch(typ){
        case UART_PKT_TYP_ACL:
            sz = ((HCI_ACL_Data*)packetStore)->totalDataLen + 4L;
            break;

        case UART_PKT_TYP_SCO:
            sz = ((HCI_SCO_Data*)packetStore)->totalDataLen + 3L;
            break;

        case UART_PKT_TYP_EVT:
            sz = ((HCI_Event*)packetStore)->totalParamLen + 2L;
            break;

        default:
            //no idea what it is...drop it on the floor
            return;
    }

    copy = malloc(sz + 1);
    if(!copy) return; //cannot alloc -> fail

    copy[0] = typ;
    for(i = 0; i < sz; i++) copy[i + 1] = packet[i];
    for(i = 0; i < PACKET_RX_BACKLOG_SZ; i++) if(!backlog[i]) break;
    if(i == PACKET_RX_BACKLOG_SZ){ //we have to drop something

        #if BT_VERBOSE

            dbgPrintf("BT: dropping backlog item: %d, 0x%x\n", backlog[0][0], backlog[0][1]);

        #endif
        free(backlog[0]);
        for(i = 0; i < PACKET_RX_BACKLOG_SZ - 1; i++) backlog[i] = backlog[i + 1];
    }
    backlog[i] = copy;
}

static uint8_t btRxPacket(void){  //return type

    uint8_t typ;
    uint8_t* dst;
    unsigned sz;

    btUartRecv(&typ, 1);	//get H4 packet type
    switch(typ){
        case UART_PKT_TYP_ACL:
            sz = 4L;
            break;

        case UART_PKT_TYP_SCO:
            sz = 3L;
            break;

        case UART_PKT_TYP_EVT:
            sz = 2L;
            break;

        default:
            //no idea what it is...drop it on the floor
            return 0;
    }

    dst = packet + sz;
    btUartRecv(packet, sz);

    switch(typ){
        case UART_PKT_TYP_ACL:
            sz = ((HCI_ACL_Data*)packetStore)->totalDataLen;
            break;

        case UART_PKT_TYP_SCO:
            sz = ((HCI_SCO_Data*)packetStore)->totalDataLen;
            break;

        case UART_PKT_TYP_EVT:
            sz = ((HCI_Event*)packetStore)->totalParamLen;
            break;

        default:
            //no idea what it is...drop it on the floor
            return 0;
    }

    if(dst + sz > packet + BT_RX_BUF_SZ){

        dbgPrintf("BT: Incoming packet too big. Dropping\n");
        while(sz--) btUartRecv(dst, 1);
        return 0;
    }
    else btUartRecv(dst, sz);

    #if BT_VERBOSE
    {
        uint8_t *start = packet, *end = dst + sz;

        dbgPrintf("RX: %02X", typ);
        while(start < end) dbgPrintf(" %02X", *start++);
        dbgPrintf("\n");
    }
    #endif

    return typ;
}

static void btTaskF(void* ptr){

    HCI_Event* e = (HCI_Event*)packetStore;
    HCI_ACL_Data* acl = (HCI_ACL_Data*)packetStore;
    uint8_t* packetState;
    uint16_t conn;
    uint8_t mac[6];
    uint8_t buf[16];
    unsigned i, j;


    while(!btThreadDie){

        uint8_t typ;

        if((typ = btRxPacket())){

            if(typ == UART_PKT_TYP_ACL){

                cbks.BtAclDataRxF(cbks.userData, acl->info & 0x0FFF, ((acl->info >> 12) & 3) == 2, acl->info >> 14, acl->data, acl->totalDataLen);
            }
            else if(typ == UART_PKT_TYP_EVT && e->eventCode == HCI_EVT_Connection_Request_Event){

                uint32_t dc = e->params[6] + (((uint32_t)e->params[7]) << 8) + (((uint32_t)e->params[8]) << 16);

                for(i = 0; i < sizeof(mac); i++) mac[i] = e->params[i];

                if(cbks.BtConnReqF(cbks.userData, mac, dc, e->params[9])){ //accept it

                    packetState = hciCmdPacketStart(HCI_OGF_Link_Control, HCI_CMD_Accept_Connection_Request);
                    i = 1;
                }
                else{ //reject it

                    packetState = hciCmdPacketStart(HCI_OGF_Link_Control, HCI_CMD_Reject_Connection_Request);
                    i = 0x0F; //rejected...
                }
                packetState = hciCmdPacketAddU8(packetState, mac[0]);
                packetState = hciCmdPacketAddU8(packetState, mac[1]);
                packetState = hciCmdPacketAddU8(packetState, mac[2]);
                packetState = hciCmdPacketAddU8(packetState, mac[3]);
                packetState = hciCmdPacketAddU8(packetState, mac[4]);
                packetState = hciCmdPacketAddU8(packetState, mac[5]);
                packetState = hciCmdPacketAddU8(packetState, i); //we'll be the slave on the connection...for now
                hciCmdPacketFinish(packetState);
                btTxCmdPacket();
            }
            else if(typ == UART_PKT_TYP_EVT && e->eventCode == HCI_EVT_Connection_Complete_Event && !e->params[0]){

                conn = e->params[1] + (((uint32_t)e->params[2]) << 8);

                cbks.BtConnStartF(cbks.userData, conn, e->params + 3, e->params[9], e->params[10]);
            }
            else if(typ == UART_PKT_TYP_EVT && e->eventCode == HCI_EVT_Disconnection_Complete_Event){

                BtEnqueuedNode *t, *n = enqueuedPackets, *p = NULL;
                conn = e->params[1] + (((uint32_t)e->params[2]) << 8);

                cbks.BtConnEndF(cbks.userData, conn, e->params[3]);

                while(n){

                    if(n->conn == conn){

                        if(p) p->next = n->next;
                        else enqueuedPackets = n->next;
                        t = n;
                        n = n->next;
                        sg_free(t->buf);
                        free(t->buf);
                        free(t);
                    }
                    else{

                        p = n;
                        n = n->next;
                    }
                }
            }
            else if(typ == UART_PKT_TYP_EVT && e->eventCode == HCI_EVT_PIN_Code_Request_Event){

                for(i = 0; i < sizeof(mac); i++) mac[i] = e->params[i];
                i = cbks.BtPinRequestF(cbks.userData, mac, buf);
                packetState = hciCmdPacketStart(HCI_OGF_Link_Control, i ? HCI_CMD_PIN_Code_Request_Reply : HCI_CMD_PIN_Code_Request_Negative_Reply);
                packetState = hciCmdPacketAddU8(packetState, mac[0]);
                packetState = hciCmdPacketAddU8(packetState, mac[1]);
                packetState = hciCmdPacketAddU8(packetState, mac[2]);
                packetState = hciCmdPacketAddU8(packetState, mac[3]);
                packetState = hciCmdPacketAddU8(packetState, mac[4]);
                packetState = hciCmdPacketAddU8(packetState, mac[5]);
                
                if(i){ //accept

                    packetState = hciCmdPacketAddU8(packetState, i);
                    for(j = 0; j < 16; j++) packetState = hciCmdPacketAddU8(packetState, buf[j]);
                }
                hciCmdPacketFinish(packetState);
                btTxCmdPacket();
            }
            else if(typ == UART_PKT_TYP_EVT && e->eventCode == HCI_EVT_Number_Of_Completed_Packets_Event){

                uint8_t numHandles = e->params[0];

                for(i = 0; i < numHandles; i++) gAclPacketsCanSend += (((uint16_t)e->params[1 + i * 4 + 3]) << 8) | e->params[1 + i * 4 + 2];

                while(gAclPacketsCanSend && enqueuedPackets){

                    BtEnqueuedNode* n = enqueuedPackets;

                    enqueuedPackets = n->next;
                    btAclDoDataTx(n->conn, n->first, n->bcastType, n->buf);
                    free(n);
                }
            }
            else if(typ == UART_PKT_TYP_EVT && e->eventCode == HCI_EVT_Link_Key_Request_Event){

                for(i = 0; i < sizeof(mac); i++) mac[i] = e->params[i];
                i = cbks.BtLinkKeyRequestF(cbks.userData, mac, buf);
                packetState = hciCmdPacketStart(HCI_OGF_Link_Control, i ? HCI_CMD_Link_Key_Request_Reply : HCI_CMD_Link_Key_Request_Negative_Reply);
                packetState = hciCmdPacketAddU8(packetState, mac[0]);
                packetState = hciCmdPacketAddU8(packetState, mac[1]);
                packetState = hciCmdPacketAddU8(packetState, mac[2]);
                packetState = hciCmdPacketAddU8(packetState, mac[3]);
                packetState = hciCmdPacketAddU8(packetState, mac[4]);
                packetState = hciCmdPacketAddU8(packetState, mac[5]);
                
                if(i){ //link key given to us

                    for(j = 0; j < 16; j++) packetState = hciCmdPacketAddU8(packetState, buf[j]);
                }
                hciCmdPacketFinish(packetState);
                btTxCmdPacket();
            }
            else if(typ == UART_PKT_TYP_EVT && e->eventCode == HCI_EVT_Link_Key_Notification_Event){

                for(i = 0; i < sizeof(mac); i++) mac[i] = e->params[i];
                for(i = 0; i < 16; i++) buf[i] = e->params[i + sizeof(mac)];

                cbks.BtLinkKeyCreatedF(cbks.userData, mac, buf);
            }
        #if SUPORT_SSP //this was done last minute, but should work :) -DG

            else if(typ == UART_PKT_TYP_EVT && e->eventCode == HCI_EVT_IO_Capability_Request_Event){

                for(i = 0; i < sizeof(mac); i++) mac[i] = e->params[i];

                packetState = hciCmdPacketStart(HCI_OGF_Link_Control, HCI_CMD_IO_Capability_Request_Reply);
                packetState = hciCmdPacketAddU8(packetState, mac[0]);
                packetState = hciCmdPacketAddU8(packetState, mac[1]);
                packetState = hciCmdPacketAddU8(packetState, mac[2]);
                packetState = hciCmdPacketAddU8(packetState, mac[3]);
                packetState = hciCmdPacketAddU8(packetState, mac[4]);
                packetState = hciCmdPacketAddU8(packetState, mac[5]);
                
                packetState = hciCmdPacketAddU8(packetState, 0); //we claim to be display-only - it works for us
                packetState = hciCmdPacketAddU8(packetState, 0); //we do not support OOB
                packetState = hciCmdPacketAddU8(packetState, 2); //we don't care about MITM and like Dedicated Bonding
                hciCmdPacketFinish(packetState);
                btTxCmdPacket();
            }
            else if(typ == UART_PKT_TYP_EVT && e->eventCode == HCI_EVT_User_Confirmation_Request_Event){

                for(i = 0; i < sizeof(mac); i++) mac[i] = e->params[i];
                uint32_t val = 0;

                for(i = 0; i < 4; i++) val = (val << 8) | e->params[sizeof(mac) + 3 - i];

                //we are disaply-only so accept it unconditionally
                packetState = hciCmdPacketStart(HCI_OGF_Link_Control, HCI_CMD_User_Confirmation_Request_Reply);
                packetState = hciCmdPacketAddU8(packetState, mac[0]);
                packetState = hciCmdPacketAddU8(packetState, mac[1]);
                packetState = hciCmdPacketAddU8(packetState, mac[2]);
                packetState = hciCmdPacketAddU8(packetState, mac[3]);
                packetState = hciCmdPacketAddU8(packetState, mac[4]);
                packetState = hciCmdPacketAddU8(packetState, mac[5]);
                hciCmdPacketFinish(packetState);
                btTxCmdPacket();

                cbks.BtSspShow(cbks.userData, mac, val);
            }
            else if(typ == UART_PKT_TYP_EVT && e->eventCode == HCI_EVT_Simple_Pairing_Complete_Event){

                for(i = 0; i < sizeof(mac); i++) mac[i] = e->params[i];
                uint32_t val = 0;

                for(i = 0; i < 4; i++) val = (val << 8) | e->params[sizeof(mac) + 3 - i];

                cbks.BtSspShow(cbks.userData, mac, BT_SSP_DONE_VAL);
            }

        #endif
            else{

                btEnqueuePacket(typ);
            }
        }
    }
    btThreadDie = 0;
}

static char btTryRxEventPacket(uint8_t wantedType){

    uint8_t i, j;

    for(i = 0; i < PACKET_RX_BACKLOG_SZ; i++){

        if(backlog[i] && backlog[i][0] == UART_PKT_TYP_EVT && (!wantedType || backlog[i][1] == wantedType)){

            for(j = 0; j < 2; j++) packet[j] = backlog[i][j + 1]; //copy packet header
            for(j = 0; j < ((HCI_Event*)packetStore)->totalParamLen; j++) packet[j + 2] = backlog[i][j + 3];
            free(backlog[i]);
            for(; i < PACKET_RX_BACKLOG_SZ - 1; i++) backlog[i] = backlog[i + 1];
            backlog[i] = NULL;
            return 1;
        }
    }
    return 0;
}

static void btRxEventPacket(uint8_t wantedType){

    while(!btTryRxEventPacket(wantedType)) coopYield();
}

char btInit(const BtFuncs* btf){

    HCI_Cmd* cmd;
    HCI_Event* evt = (HCI_Event*)packetStore;
    int num = 0;
    const uint8_t* script = cc256x_init_script;
    uint8_t* packetState;
    int i;

dbgPrintf("inBtInit\n");

    NVIC_DisableIRQ(USART0_IRQn);

    initBtUart(1);
    gpioSetVal(RESET, 0);
    delay_ms(15);
    gpioSetVal(RESET, 1);
    delay_ms(70);
    //set speed
    packetState = hciCmdPacketStart(0x3f, 0x336);
    packetState = hciCmdPacketAddU32(packetState, BT_BAUDRATE);
    hciCmdPacketFinish(packetState);
    btTxCmdPacket();
    btRxPacket(); //it responds at old speed
    delay_ms(100);
    initBtUart(0);
    btThreadDie = 0;
    if(!coopSpawn(btTaskF, NULL, 2048)){
        dbgPrintf("Failed to start BT task\n");
        return 0;
    }
    dbgPrintf("Bt initing...\n");

    //init script
    while(*script++){

        dbgPrintf("\r%d", num++);
        cmd = (HCI_Cmd*)script;
        btTxCmdPacketEx(cmd);
        script += 3 + cmd->totalParamLen;
        btRxEventPacket(0);
        #if BT_VERBOSE
            dbgPrintf(" -> %d, %d:", evt->eventCode ,evt->totalParamLen);
            for(i = 0; i < evt->totalParamLen; i++) dbgPrintf(" %02X", evt->params[i]);
            dbgPrintf("\n");
        #endif
    }

    //get buffer size
    packetState = hciCmdPacketStart(HCI_OGF_Informational, HCI_CMD_Read_Buffer_Size);
    hciCmdPacketFinish(packetState);
    btTxCmdPacket();
    do{
        btRxEventPacket(HCI_EVT_Command_Complete_Event);
    }while(evt->params[1] != (HCI_OPCODE(HCI_OGF_Informational, HCI_CMD_Read_Buffer_Size) & 0xFF) ||
              evt->params[2] != (HCI_OPCODE(HCI_OGF_Informational, HCI_CMD_Read_Buffer_Size) >> 8));

    uint16_t aclLen, aclNum, scoNum;
    uint8_t scoLen;

    aclLen = (((uint16_t)evt->params[5]) << 8) | evt->params[4];
    scoLen = evt->params[6];
    aclNum = (((uint16_t)evt->params[8]) << 8) | evt->params[7];
    scoNum = (((uint16_t)evt->params[10]) << 8) | evt->params[9];

    #if BT_VERBOSE
        dbgPrintf("BT chip buffers: %ux%ub ACL, %ux%ub SCO\n", aclNum, aclLen, scoNum, scoLen);
    #endif

    gAclPacketsCanSend = aclNum;

    //set connectibility/discoverability
    pageState = 0;
    btDiscoverableConnectable();

    //enable simple passcodes
    if(SUPORT_SSP){
      packetState = hciCmdPacketStart(HCI_OGF_Controller_and_Baseband, HCI_CMD_Write_Simple_Pairing_Mode);
      packetState = hciCmdPacketAddU8(packetState, 1); //enable it
      hciCmdPacketFinish(packetState);
      btTxCmdPacket();
      do{
        btRxEventPacket(HCI_EVT_Command_Complete_Event);
      }while(evt->params[1] != (HCI_OPCODE(HCI_OGF_Controller_and_Baseband, HCI_CMD_Write_Simple_Pairing_Mode) & 0xFF) ||
              evt->params[2] != (HCI_OPCODE(HCI_OGF_Controller_and_Baseband, HCI_CMD_Write_Simple_Pairing_Mode) >> 8));
    }

    cbks = *btf;

    dbgPrintf("\nBT up\n");

    return 1;
}

void btDeinit(void){

    int i;

    btThreadDie = 1;
    while(btThreadDie) coopYield();

    for(i = 0; i < PACKET_RX_BACKLOG_SZ; i++) if(backlog[i]) free(backlog[i]);
}

char btLocalMac(uint8_t* buf){

    int i;
    HCI_Event* evt = (HCI_Event*)packetStore;
    uint8_t* packetState;

    packetState = hciCmdPacketStart(HCI_OGF_Informational, HCI_CMD_Read_BD_ADDR);
    hciCmdPacketFinish(packetState);
    btTxCmdPacket();
    btRxEventPacket(HCI_EVT_Command_Complete_Event);
    if(evt->totalParamLen != 10 ||
          evt->params[1] != (HCI_OPCODE(HCI_OGF_Informational, HCI_CMD_Read_BD_ADDR) & 0xFF) ||
          evt->params[2] != (HCI_OPCODE(HCI_OGF_Informational, HCI_CMD_Read_BD_ADDR) >> 8) || evt->params[3] != 0){
        return 0;
    }

    for(i = 0; i < 6; i++) buf[i] = evt->params[4 + i];
    return 1;
}

char btSetLocalName(const char* name){

    HCI_Cmd* cmd = (HCI_Cmd*)packetStore;
    HCI_Event* evt = (HCI_Event*)packetStore;
    uint8_t* packetState;

    packetState = hciCmdPacketStart(HCI_OGF_Controller_and_Baseband, HCI_CMD_Change_Local_Name);
    while(name && *name) packetState = hciCmdPacketAddU8(packetState, *name++);
    packetState = hciCmdPacketAddU8(packetState, 0);
    hciCmdPacketFinish(packetState);
    if(cmd->totalParamLen > 248) return 0;	//too long
    cmd->totalParamLen = 248;
    btTxCmdPacket();
    btRxEventPacket(HCI_EVT_Command_Complete_Event);
    
    if(evt->totalParamLen != 4 ||
          evt->params[1] != (HCI_OPCODE(HCI_OGF_Controller_and_Baseband, HCI_CMD_Change_Local_Name) & 0xFF) ||
          evt->params[2] != (HCI_OPCODE(HCI_OGF_Controller_and_Baseband, HCI_CMD_Change_Local_Name) >> 8) || evt->params[3] != 0){
        return 0;
    }
    return 1;
}

void btScan(void){

    //HCI_Cmd* cmd = (HCI_Cmd*)packet;
    HCI_Event* evt = (HCI_Event*)packet;
    uint8_t* packetState;
    int i, done = 0;

    packetState = hciCmdPacketStart(HCI_OGF_Link_Control, HCI_CMD_Inquiry);
    packetState = hciCmdPacketAddU24(packetState, HCI_LAP_Unlimited_Inquiry);
    packetState = hciCmdPacketAddU8(packetState, 0x30);
    packetState = hciCmdPacketAddU8(packetState, 0);
    hciCmdPacketFinish(packetState);
    btTxCmdPacket();

    while(1){
        coopYield();
        if(!done && btTryRxEventPacket(HCI_EVT_Inquiry_Result_Event)){

            uint8_t* MACs  = evt->params + evt->params[0]*0  + 1;
            uint8_t* PSRMs = evt->params + evt->params[0]*6  + 1;
            uint8_t* PSPMs = evt->params + evt->params[0]*7  + 1;
            uint8_t* PSMs  = evt->params + evt->params[0]*8  + 1;
            uint8_t* DCs   = evt->params + evt->params[0]*9  + 1;
            uint8_t* COs   = evt->params + evt->params[0]*12 + 1;

            for(i = 0; i < evt->params[0]; i++){

                BtDiscoveryResult dr;

                dr.dc = DCs[0] + (((uint32_t)DCs[1]) << 8) + (((uint32_t)DCs[2]) << 16)         ;     
                dr.mac[0] = *MACs++;
                dr.mac[1] = *MACs++;
                dr.mac[2] = *MACs++;
                dr.mac[3] = *MACs++;
                dr.mac[4] = *MACs++;
                dr.mac[5] = *MACs++;
                dr.PSRM = *PSRMs++;
                dr.PSPM = *PSPMs++;
                dr.PSM = *PSMs++;
                dr.co = (((uint16_t)COs[1]) << 8) + COs[0];

                if(!cbks.BtDiscoveryF(cbks.userData, &dr)){

                    packetState = hciCmdPacketStart(HCI_OGF_Link_Control, HCI_CMD_Inquiry_Cancel);
                    hciCmdPacketFinish(packetState);
                    btTxCmdPacket();
                    done = 1;
                    break;
                }
                COs += 2;
                DCs += 3;
            }
        }
        if(btTryRxEventPacket(HCI_EVT_Inquiry_Complete_Event)) break;
        if(btTryRxEventPacket(HCI_EVT_Command_Complete_Event)) break;
    }
}

char btGetRemoteName(const uint8_t* mac, uint8_t PSRM, uint8_t PSM, uint16_t co, char* nameBuf){

    HCI_Event* evt = (HCI_Event*)packet;
    uint8_t* packetState;
    int i = 0;

    packetState = hciCmdPacketStart(HCI_OGF_Link_Control, HCI_CMD_Remote_Name_Request);
    packetState = hciCmdPacketAddU8(packetState, mac[0]);
    packetState = hciCmdPacketAddU8(packetState, mac[1]);
    packetState = hciCmdPacketAddU8(packetState, mac[2]);
    packetState = hciCmdPacketAddU8(packetState, mac[3]);
    packetState = hciCmdPacketAddU8(packetState, mac[4]);
    packetState = hciCmdPacketAddU8(packetState, mac[5]);
    packetState = hciCmdPacketAddU8(packetState, PSRM);
    packetState = hciCmdPacketAddU8(packetState, PSM);
    packetState = hciCmdPacketAddU16(packetState, co);
    hciCmdPacketFinish(packetState);
    btTxCmdPacket();

    btRxEventPacket(HCI_EVT_Remote_Name_Request_Complete_Event);

    if(evt->params[0] == 0){

        while(i < 248 && evt->params[7 + i]){
            nameBuf[i] = evt->params[7 + i];
            i++;
        }
        nameBuf[i] = 0;
        return 1;
    }
    else return 0;
}

static char btDiscoverableConnectable(void){

    HCI_Event* evt = (HCI_Event*)packet;
    uint8_t* packetState;

    packetState = hciCmdPacketStart(HCI_OGF_Controller_and_Baseband, HCI_CMD_Write_Scan_Enable);
    packetState = hciCmdPacketAddU8(packetState, pageState);
    hciCmdPacketFinish(packetState);
    btTxCmdPacket();
    btRxEventPacket(HCI_EVT_Command_Complete_Event);
    if(evt->totalParamLen != 4 ||
          evt->params[1] != (HCI_OPCODE(HCI_OGF_Controller_and_Baseband, HCI_CMD_Write_Scan_Enable) & 0xFF) ||
          evt->params[2] != (HCI_OPCODE(HCI_OGF_Controller_and_Baseband, HCI_CMD_Write_Scan_Enable) >> 8) || evt->params[3] != 0){
        return 0;
    }

    return 1;
}

char btDiscoverable(char on){

    uint8_t nv = (pageState &~ PAGE_STATE_INQUIRY) | (on ? PAGE_STATE_INQUIRY : 0);
    if(nv == pageState) return 1;
    pageState = nv;

    return btDiscoverableConnectable();
}

char btConnectable(char on){

    uint8_t nv = (pageState &~ PAGE_STATE_PAGE) | (on ? PAGE_STATE_PAGE : 0);
    if(nv == pageState) return 1;
    pageState = nv;

    return btDiscoverableConnectable();
}

char btSetDeviceClass(uint32_t cls){

    HCI_Event* evt = (HCI_Event*)packet;
    uint8_t* packetState;

    packetState = hciCmdPacketStart(HCI_OGF_Controller_and_Baseband, HCI_CMD_Write_Class_Of_Device);
    packetState = hciCmdPacketAddU24(packetState, cls);
    hciCmdPacketFinish(packetState);
    btTxCmdPacket();
    btRxEventPacket(HCI_EVT_Command_Complete_Event);
    if(evt->totalParamLen != 4 ||
          evt->params[1] != (HCI_OPCODE(HCI_OGF_Controller_and_Baseband, HCI_CMD_Write_Class_Of_Device) & 0xFF) ||
          evt->params[2] != (HCI_OPCODE(HCI_OGF_Controller_and_Baseband, HCI_CMD_Write_Class_Of_Device) >> 8) || evt->params[3] != 0){
        return 0;
    }

    return 1;
}














const uint8_t cc256x_init_script[] = {
    // #--------------------------------------------------------------------------------
    // # Description : Trio Orca 5500 L ROM Initialization Script
    // #
    // # Compatibility: Trio/Orca/5500, 6.0.15 ROM
    // #
    // # Last Updated: 09-Aug-2011  10:06:07.86
    // #
    // # Version     : TI_P6_15.41
    // #
    // #
    // #
    // # Trio LMP Subversion: 1f29
    // # Orca LMP Subversion: 1b29
    // #
    // # Notes       : Use this script on Trio, Orca or 5500, 6.0.15 ROM device only (FW v6.0.15)
    // #--------------------------------------------------------------------------------
    // 
    // #################################################################
    // ## START of Panasonic Adds-On
    // #################################################################
    // 
    // ## Change UART baudrate
    // 
    // 
    // #################################################################
    // ## END of Panasonic Adds-On
    // #################################################################
    // 
    0x01, 0x37, 0xfe, 0x02, 0x06, 0x0f, 

    // 
    // 
    0x01, 0x05, 0xff, 0xff, 0xa0, 0x62, 0x08, 0x00, 0xfa, 0x06, 0x0f, 0x3d, 0x29, 0x05, 0xc0, 
    0x03, 0xc0, 0x1e, 0x08, 0x05, 0x00, 0x04, 0xc0, 0x03, 0xc0, 0x1e, 0x08, 0x3d, 0x01, 0x04, 
    0xc0, 0x03, 0xc0, 0x1e, 0x08, 0x76, 0x02, 0x04, 0xc0, 0x03, 0xc0, 0x1e, 0x08, 0xae, 0x03, 
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    0x00, 0x00, 0x00, 0x00, 0x00, 0x00, 0x00, 0x00, 0x00, 

    // 
    // 
    0x01, 0xdc, 0xfd, 0x05, 0x00, 0x00, 0x00, 0x00, 0x12, 

    0x01, 0x0f, 0xfd, 0x01, 0x01, 

    // 
    // 
    // ##--------------------------------------------------------------------------------
    // ## Description:   QRCA_L_TRIOL PHY FW Initialization Script
    // ## Version:       3.17_3 (based on ROM version)
    // ##--------------------------------------------------------------------------------
    0x01, 0x01, 0xff, 0x06, 0xc6, 0x32, 0x19, 0x00, 0x10, 0x10, 

    0x01, 0x01, 0xff, 0x06, 0x60, 0x32, 0x19, 0x00, 0x32, 0x10, 
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    0x01, 0x80, 0xfd, 0x06, 0x3c, 0xf0, 0x5f, 0x00, 0x00, 0x00, 

    // 
    // 
    // 
    0x01, 0x38, 0xfe, 0x00, 

    // 
    // # BLE
    // #--------------------------------------------------------------------------------
    // # Description:   BRF6450 WB FW Initialization Script
    // #
    // # Compatibility: BRF6450 PG1 ROM
    // #
    // # Last Updated:  07-Oct-2010  15:19:44.57
    // #
    // # Version:       1.0
    // #
    // #--------------------------------------------------------------------------------
    // 
    // 
    // #BLE Enable
    0x01, 0x5b, 0xfd, 0x02, 0x01, 0x01, 

    // 
    // # Disable Cortex Sleep
    0x01, 0xa8, 0xfd, 0x01, 0x01, 

    // 
    // 
    // # Cortex Reset (hold in reset while loading IMEM)
    0x01, 0x09, 0xfd, 0x08, 0x00, 0xc0, 0x1b, 0x00, 0x01, 0x00, 0x01, 0x00, 

    // ########################
    // # Patch Start
    // ########################
    // 
    0x01, 0x05, 0xff, 0x41, 0x60, 0x5c, 0x1b, 0x00, 0x3c, 0x01, 0x68, 0xb1, 0xf1, 0xff, 0x3f, 
    0x1c, 0xbf, 0x49, 0x1c, 0x01, 0x60, 0x13, 0xd1, 0x41, 0x68, 0x00, 0x23, 0x03, 0x60, 0x01, 
    0xf0, 0x7f, 0x02, 0x7f, 0x2a, 0x04, 0xbf, 0x21, 0xf0, 0x7f, 0x01, 0x41, 0x60, 0x4f, 0xea, 
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    0x00, 0x00, 0x00, 0x00, 0x00, 0x00, 0x00, 0x00, 0x00, 0x00, 

    // 
    // ########################
    // # Patch End
    // ########################
    // 
    // #release Cortex Reset
    0x01, 0x09, 0xfd, 0x08, 0x00, 0xc0, 0x1b, 0x00, 0x00, 0x00, 0x01, 0x00, 

    // 
    // # Enable Cortex Sleep
    0x01, 0xa8, 0xfd, 0x01, 0x00, 

    // 
    // #RESET BLE
    0x01, 0x5b, 0xfd, 0x02, 0x01, 0x00, 

    // 
    0x01, 0xdd, 0xfd, 0x01, 0x01, 

    // 
    // #################################################################
    // ## START of Panasonic Adds-On
    // #################################################################
    // 
    // ## Enable fast clock XTAL support
    0x01, 0x1c, 0xfd, 0x14, 0x01, 0x88, 0x13, 0x00, 0x00, 0xd0, 0x07, 0x00, 0x00, 0xff, 0xff, 
    0x04, 0xff, 0xff, 0xff, 0xfa, 0x00, 0x00, 0x00, 0x00, 

    // 
    // ## Enable LPS
    0x01, 0x2e, 0xfd, 0x0d, 0x01, 0x58, 0x02, 0x06, 0x00, 0x1e, 0x00, 0x00, 0x00, 0x00, 0x00, 
    0x00, 0x00, 

    // 
    // ## Enable eHCILL
//    0x01, 0x2b, 0xfd, 0x05, 0x10, 0x00, 0x50, 0x00, 0x96, 

//DGV: disable eHCILL
    0x01, 0x0c, 0xfd, 0x09 , 0x01, 0, 0,  0xff, 0xff, 0xff, 0xff, 100, 0,

    // 
 //   0x01, 0x0c, 0xfd, 0x09, 0x01, 0x01, 0x00, 0xff, 0xff, 0xff, 0xff, 0x64, 0x00, 

    // 
    // #################################################################
    // ## END of Panasonic Adds-On
    // #################################################################


    //terminate
    0x00
};

